## arch/arm/Kconfig
```kconfig
menu "ARM architecture"
	depends on ARM

#
# cpu arch
#
config SYS_ARCH
	string
	default "arm"

config ARM64
	bool
	select PHYS_64BIT
	select SYS_CACHE_SHIFT_6

config HAS_VBAR
	bool

config HAS_THUMB2
	bool

config CPU_ARM720T
	bool
	select SYS_CACHE_SHIFT_5

config CPU_ARM920T
	bool
	select SYS_CACHE_SHIFT_5

config CPU_ARM926EJS
	bool
	select SYS_CACHE_SHIFT_5

config CPU_ARM946ES
	bool
	select SYS_CACHE_SHIFT_5

config CPU_ARM1136
	bool
	select SYS_CACHE_SHIFT_5

config CPU_ARM1176
	bool
	select HAS_VBAR
	select SYS_CACHE_SHIFT_5

config CPU_V7
	bool
	select HAS_VBAR
	select HAS_THUMB2
	select SYS_CACHE_SHIFT_6

config CPU_V7M
	bool
	select HAS_THUMB2
	select SYS_CACHE_SHIFT_5

config CPU_PXA
	bool
	select SYS_CACHE_SHIFT_5

config CPU_SA1100
	bool
	select SYS_CACHE_SHIFT_5

config SYS_CPU
	string
	default "arm720t" if CPU_ARM720T
	default "arm920t" if CPU_ARM920T
	default "arm926ejs" if CPU_ARM926EJS
	default "arm946es" if CPU_ARM946ES
	default "arm1136" if CPU_ARM1136
	default "arm1176" if CPU_ARM1176
	default "armv7" if CPU_V7
	default "armv7m" if CPU_V7M
	default "pxa" if CPU_PXA
	default "sa1100" if CPU_SA1100
	default "armv8" if ARM64

config SYS_CACHE_SHIFT_5
	bool

config SYS_CACHE_SHIFT_6
	bool

config SYS_CACHE_SHIFT_7
	bool

config SYS_CACHELINE_SIZE
	int
	default 128 if SYS_CACHE_SHIFT_7
	default 64 if SYS_CACHE_SHIFT_6
	default 32 if SYS_CACHE_SHIFT_5


#
# select target board
#
choice
	prompt "Select target"
	default STM32

config BOARD_ST
	bool "ST boards"

endchoice

source "board/st/Kconfig"

#
# select cpu endian
#
config CPU_LITTLE_ENDIAN
	bool "Little Endian"
	default y


endmenu
```

## board/st/nucleo_stm32f401re/Kconfig
```kconfig
if TARGET_NUCLEO_STM32F401RE

config SYS_DEFCONFIG
	bool
	default y
	select CPU_V7M
	select STM32F4
	select CLOCK
	select PINCTRL

config CPU_V7M_CM4
	bool
	default y

config SYS_BOARD
	string
	default "nucleo_stm32f401re"

config SYS_VENDOR
	string
	default "st"

config SYS_SOC
	string
	default "stm32f4"

config STM32F4
	bool

endif
```

## driver/core/Kconfig
```kconfig
menu "Generic Options"

#
# Device tree control
#
config OF_CONTROL
	bool "Enable Device Tree Control"
	default n
	select OF_LIBFDT

config DEVICE_TREE
	depends on OF_CONTROL
	string "Default device tree"

endmenu
```

## driver/led/Kconfig
```kconfig
menuconfig LED
	bool "LED support"
	default y

if LED

config LED_GPIO
	bool "LED GPIO"
	default n

endif
```

## driver/net/Kconfig
```kconfig
menuconfig NETDEVICE
	bool "Network device support"
	default n

if NETDEVICE

endif # NETDEIVES
```

## library/Kconfig
```kconfig
menu "Select library"

config OF_LIBFDT
	bool "Enable FDT library"
	default n

endmenu
```

## scripts/Kconfig.rtos
```kconfig
####################################################################
#
# config.rtos
#   -- Top level configuration file
#
# Feb 24, 2017. Zhu Mingjun(zhumj1991@163.com)
#
####################################################################

#
# Optimization and debugging
#

menu "General setup"

config CROSS_COMPILE
	string "Cross compiler prefix"

config CC_OPTIMIZE_FOR_SIZE
	bool "Optimisize size"
	default n

#######################################
comment "Debug configure"

config CC_DEBUG
	bool "Generate debug information"
	default n
	help
	  This option will add '-g' to CC_FLAGS.

config CODE_DEBUG
	bool "Debug code in ram"
	default n
	help
	  This option will link code in ram, not use any rom/flash memories.
	  User should use 'make clean' after enabling this option.

config ENABLE_DEBUG
	bool "Enable dbg information"
	default n
	help
	  This option will enable dbg() to output system debug information
	  through a uart.

config EARLY_PRINTF
	bool "Enable early printf"
	default n
	help
	  System will initialize a early uart and print some dbg information
	  before driver system bootup.

config RTOS_PRINTF
	bool "Enable RTOS printf"
	default y
	help
	  This option will enable rtos_printf(), recommand to use it instead
	  of newlib printf(). Newlib printf use lots of stack, it's bad for
	  low memory system.

endmenu		# Genetal setup
```
